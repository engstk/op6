## Documentation/devicetree/bindings/input/oneplus,fpdetect.txt
```
oneplus,fpdetect


Required properties:

- compatible : should be compatible = "oneplus,fpdetect" ;

example:

	fingerprint_detect {
		compatible = "oneplus,fpdetect";
		fp-gpio-id0    = <&tlmm 91 0>;
		fp-gpio-id1    = <&tlmm 92 0>;
		fp-gpio-id2    = <&tlmm 95 0>;
		pinctrl-names = "fp_en_init", "fp_id_init";
		pinctrl-0 = <&fp_en_init>;
		pinctrl-1 = <&fp_id0_init &fp_id1_init &fp_id2_init>;
		oem,dumpling;
	};
```

## Documentation/devicetree/bindings/input/touchscreen/s3320.txt
```
HWK,synaptics,s3320


Required properties:

- compatible : should be compatible = "HWK,synaptics,s3320";

example:
	synaptics-rmi-ts@20 {
		compatible = "HWK,synaptics,s3320";
		reg = <0x20>;
		interrupt-parent = <&tlmm>;
		interrupts = <125 0x2008>;
		//vcc_i2c_1v8-supply = <&pm8998_l6>;
		vdd_2v8-supply = <&pm8998_l28>;
		synaptics,tx-rx-num = <15 30>;
		//synaptics,vdd-voltage = <1808000 1808000>;
		synaptics,avdd-voltage = <3008000 3008000>;
		//synaptics,vdd-current = <40000>;
		synaptics,avdd-current = <20000>;
		synaptics,display-coords = <1080 2160>;
		synaptics,panel-coords = <1080 2160>;
		synaptics,reset-gpio = <&tlmm 99 0x00>;
		synaptics,irq-gpio = <&tlmm 125 0x2008>;
		synaptics,1v8-gpio = <&tlmm 88 0x2008>;
		oem,support_1080x2160_tp;
		oem,support_hw_poweroff;
		pinctrl-names = "pmx_ts_active", "pmx_ts_suspend";
		pinctrl-0 = <&ts_active>;
		pinctrl-1 = <&ts_int_suspend &ts_reset_suspend>;
	};
```

## Documentation/devicetree/bindings/power/ech-wls-charger.txt
```
"ec4016,wls-charger-ec4016"



Required properties:

- compatible : should be ""ec4016,wls-charger-ec4016""


Example:
	       ech_wls_chrg@6E {
               status = "ok";
               compatible = "ec4016,wls-charger-ec4016";
               reg = <0x6E>;
               gpios = <&tlmm 85 0x1>, /* INT_IN */
                               <&tlmm 29 0x0>; /* RESET_OUT_INIT_LOW */
                       /*<&tlmm 123 0x0>;  VSYS_OUT_INIT_LOW */
```

## Documentation/devicetree/bindings/power/oneplus_fastchg.txt
```
crochip,oneplus_fastcg"



Required properties:

- compatible : should be "microchip,oneplus_fastchg"


Example:
	oneplus_fastchg@26{

               status = "ok";

               compatible = "microchip,oneplus_fastchg";

               reg = <0x26>;

               microchip,mcu-en-gpio = <&tlmm 96 0x00>;

               microchip,usb-sw-1-gpio = <&tlmm 15 0x00>;
```

## Documentation/devicetree/bindings/soc/qcom/oem,force_serial.txt
```
oem force_serial
Required Properties:
- compatible:                   Must be "compatible = "oem,force_serial".


Example:

	force_enable_serial {
		compatible = "oem,force_serial";
	};
```

## Documentation/devicetree/bindings/soc/qcom/oem,oem_serial_pinctrl.txt
```
oem serial_pinctrl
Required Properties:
- compatible:                   Must be "compatible = "oem,oem_serial_pinctrl".


Example:

	oem_serial_pinctrl {
		compatible = "oem,oem_serial_pinctrl";
		pinctrl-names = "uart_pinctrl_active","uart_pinctrl_deactive";
		pinctrl-0 = <&qupv3_se10_2uart_active>;
		pinctrl-1 = <&qupv3_se10_2uart_sleep>;
	};
```

## Documentation/devicetree/bindings/soc/qcom/oem,rf_cable.txt
```
rf_cable
Required Properties:
- compatible:                   Must be "compatible = "oem,rf_cable".


Example:

        tri_state_key {
		compatible = "oem,rf_cable";
		interrupt-parent = <&tlmm>;
		rf,cable-gpio = <&tlmm 33 0>;
		pinctrl-names = "oem_rf_cable_active", "oem_rf_cable_suspend";
		pinctrl-0 = <&oem_rf_cable_active>;
		pinctrl-1 = <&oem_rf_cable_suspend>;
};
```

## Documentation/devicetree/bindings/sound/max98927L.txt
```
maxim,max98927L

Required properties:
- compatible : should be "maxim,max98927L"

Example:
	max98927L {
		compatible = "maxim,max98927L";
	};
```

## Documentation/devicetree/bindings/sound/tfa98xx.txt
```
nxp,tfa9894

Required properties:
- compatible : should be "nxp,tfa9884"

Example:
	tfa98xx {
		compatible = "nxp,tfa9894";
	};
```

## Documentation/devicetree/bindings/tri_state_key.txt
```
oneplus

Required Properties:
- compatible:                   Must be "ompatible = "oneplus,tri-state-key".


Example:

        tri_state_key {
                compatible = "oneplus,tri-state-key";
                status = "okay";
                interrupt-parent = <&tlmm>;
                tristate,gpio_key1 = <&tlmm 24 0x00>;
                tristate,gpio_key2 = <&tlmm 52 0x00>;
                tristate,gpio_key3 = <&tlmm 126 0x00>;

                pinctrl-names = "pmx_tri_state_key_active", "pmx_tri_state_key_suspend";
                pinctrl-0 = <&tri_state_key_active>;
                pinctrl-1 = <&tri_state_key_suspend>;
        };
```

## drivers/oneplus/Kconfig
```kconfig
source "drivers/oneplus/coretech/Kconfig"
source "drivers/oneplus/drivers/Kconfig"
source "drivers/oneplus/fs/Kconfig"
source "drivers/oneplus/op_freezer/Kconfig"
```

## drivers/oneplus/coretech/Kconfig
```kconfig
config OPCHAIN
	default n
	bool "Oneplus CoreTech helper, used for opchain module"

config DEFRAG_HELPER
	default n
	bool "Oneplus CoreTech helper, used for defrag module"

config CRPL_HELPER
	default n
	bool "Oneplus CoreTech helper, used for crpl module"

config ADJ_CHAIN
	default n
	bool "Chain task adj for victim select"
	help
	 To chain task adj for any purpose

config HOUSTON
	default n
	bool "houston rocket play your temperature guard"
	help
	 Realtime temperature monitor

config MEMPLUS
	default n
	bool "memory+ feature"
	help
	 Memory+ feature

config SMART_BOOST
        bool "support smart boost feature"
        default n
        help
         Smart Boost feature
config TPD
	default n
	bool "a task placement decision for cpu limitation"
	help
	 Task affinity by decison
config CPUFREQ_BOUNCING
	default n
	bool "A power optimization feature to control excessive heating of devices"
config OPLUS_FEATURE_SUGOV_TL
	default n
	bool "A power optimization feature target loads"
```

## drivers/oneplus/drivers/Kconfig
```kconfig
config OEM_DEBUG_SUPPORT
        default y
        bool

config OEM_SYSRQ_X
	default y
	depends on OEM_DEBUG_SUPPORT
	bool "echo x > /proc/sysrq-trigger to get init process stacktrace"

config OEM_TRACE_SUPPORT
	default y
	depends on OEM_DEBUG_SUPPORT
	bool "OEM debug function, enable it will register the device, which under /dev/otracer."

config OEM_FORCE_DUMP
	default y
	bool "OEM force dump function, it will enable goto the force dump"

config PARAM_READ_WRITE
	bool "Param partition read/write support"
	default y
	help
		if you want to read/write the param partition in kernel,
		then you must say Y here.

config DEBUG_PARAM_DUMP
	bool "Param debug support"
	default n
	help
		if you want to dump contents of param partition for debug purpose

source "drivers/oneplus/drivers/input/fingerprint/Kconfig"
```
