/* Copyright (c) 2015-2017, The Linux Foundation. All rights reserved.
 *
 * This program is free software; you can redistribute it and/or modify
 * it under the terms of the GNU General Public License version 2 and
 * only version 2 as published by the Free Software Foundation.
 *
 * This program is distributed in the hope that it will be useful,
 * but WITHOUT ANY WARRANTY; without even the implied warranty of
 * MERCHANTABILITY or FITNESS FOR A PARTICULAR PURPOSE.  See the
 * GNU General Public License for more details.
 */

&mdss_mdp {
	dsi_samsung_sofef00_m_cmd: qcom,mdss_dsi_samsung_sofef00_m_cmd {
		qcom,mdss-dsi-panel-name = "samsung sofef00_m cmd mode dsi panel";
		qcom,mdss-dsi-panel-manufacture = "SAMSUNG";
		qcom,mdss-dsi-panel-version = "SOFEF00_M";
		qcom,mdss-dsi-backlight-version = "SAMSUNG";
		qcom,mdss-dsi-backlight-manufacture = "SAMSUNG";
		qcom,mdss-dsi-panel-type = "dsi_cmd_mode";
		qcom,mdss-dsi-virtual-channel-id = <0>;
		qcom,mdss-dsi-stream = <0>;
		qcom,mdss-dsi-bpp = <24>;
		qcom,mdss-dsi-underflow-color = <0xff>;
		qcom,mdss-dsi-border-color = <0>;
		qcom,mdss-dsi-reset-sequence = <1 5>, <0 2>, <1 12>;
		qcom,mdss-pan-physical-width-dimension = <68>;
		qcom,mdss-pan-physical-height-dimension = <145>;
		qcom,mdss-dsi-traffic-mode = "burst_mode";
		qcom,mdss-dsi-bllp-eof-power-mode;
		qcom,mdss-dsi-bllp-power-mode;
		qcom,mdss-dsi-lane-0-state;
		qcom,mdss-dsi-lane-1-state;
		qcom,mdss-dsi-lane-2-state;
		qcom,mdss-dsi-lane-3-state;
		qcom,mdss-dsi-dma-trigger = "trigger_sw";
		qcom,mdss-dsi-mdp-trigger = "none";
		qcom,mdss-dsi-te-pin-select = <1>;
		qcom,mdss-dsi-wr-mem-start = <0x2c>;
		qcom,mdss-dsi-wr-mem-continue = <0x3c>;
		qcom,mdss-dsi-te-dcs-command = <1>;
		qcom,mdss-dsi-te-check-enable;
		//qcom,esd-check-enabled;
		//qcom,mdss-dsi-panel-status-check-mode = "reg_read";
		//qcom,mdss-dsi-panel-status-command =
		//[06 01 00 01 05 00 02 0A 08];
		//qcom,mdss-dsi-panel-status-command-state = "dsi_lp_mode";
		//qcom,mdss-dsi-panel-status-value = <0x9c>;
		//qcom,mdss-dsi-panel-status-read-length = <1>;
		//qcom,mdss-dsi-panel-status-value-2 = <0xdc>;
		qcom,mdss-dsi-te-using-te-pin;
		qcom,mdss-dsi-lp11-init;
	    qcom,mdss-dsi-high-brightness-panel;
		qcom,mdss-dsi-acl-cmd-index = <0>;
		qcom,mdss-dsi-acl-mode-index = <1>;
		qcom,mdss-bl-high2bit;
		qcom,mdss-dsi-panel-status-check-mode = "te_signal_check";
		qcom,mdss-dsi-panel-seria-num-year-index = <12>;
		qcom,mdss-dsi-panel-seria-num-mon-index = <12>;
		qcom,mdss-dsi-panel-seria-num-day-index = <13>;
		qcom,mdss-dsi-panel-seria-num-hour-index = <14>;
		qcom,mdss-dsi-panel-seria-num-min-index = <15>;
		qcom,ulps-enabled;
		qcom,mdss-dsi-panel-hdr-enabled;
          	qcom,mdss-dsi-panel-hdr-color-primaries =
		<15635 16450 34000 16000 13250 34500 7500 3000>;
              qcom,mdss-dsi-panel-peak-brightness = <5400000>;
              qcom,mdss-dsi-panel-average-brightness = <2000000>;
              qcom,mdss-dsi-panel-blackness-level = <2000>;
		qcom,mdss-dsi-display-timings {
			timing@0{
				qcom,mdss-dsi-panel-framerate = <60>;
				qcom,mdss-dsi-panel-width = <1080>;
				qcom,mdss-dsi-panel-height = <2280>;
				qcom,mdss-dsi-h-front-porch = <112>;
				qcom,mdss-dsi-h-back-porch = <36>;
				qcom,mdss-dsi-h-pulse-width = <16>;
				qcom,mdss-dsi-h-sync-skew = <0>;
				qcom,mdss-dsi-v-back-porch = <12>;
				qcom,mdss-dsi-v-front-porch = <36>;
				qcom,mdss-dsi-v-pulse-width = <8>;
				qcom,mdss-dsi-h-left-border = <0>;
				qcom,mdss-dsi-h-right-border = <0>;
				qcom,mdss-dsi-v-top-border = <0>;
				qcom,mdss-dsi-v-bottom-border = <0>;
				qcom,mdss-dsi-panel-jitter = <0x8 0xa>;
				qcom,mdss-dsi-on-command = [
						05 01 00 00 0A 00 02 11 00
						39 01 00 00 00 00 03 F0 5A 5A
						15 01 00 00 00 00 02 35 00
						39 01 00 00 00 00 03 F0 A5 A5
						39 01 00 00 00 00 03 F0 5A 5A
						15 01 00 00 00 00 02 B0 07
						15 01 00 00 00 00 02 B6 12
						39 01 00 00 00 00 03 F0 A5 A5
						15 01 00 00 00 00 02 53 20
						15 01 00 00 00 00 02 55 00
						05 01 00 00 00 00 02 29 00
					];
				qcom,mdss-dsi-off-command = [
					05 01 00 00 28 00 02 28 00
					05 01 00 00 A0 00 02 10 00
					];
				qcom,mdss-dsi-seed-command = [
					29 01 00 00 00 00 03 F0 5A 5A
					29 01 00 00 00 00 03 E2 00 41
					29 01 00 00 00 00 02 B0 2C
					29 01 00 00 00 00 14 E2 B4 02 04 05 FF 02 00 00 FF 00 FF FF F0 E0 E1 18 FF F3 F8
					29 01 00 00 00 00 03 F0 A5 A5
					];

				qcom,mdss-dsi-panel-command = [
					29 01 00 00 00 00 03 F0 5A 5A
					29 01 00 00 00 00 03 E2 00 41
					29 01 00 00 00 00 02 B0 2C
					29 01 00 00 00 00 14 E2 B4 02 04 05 FF 02 00 00 FF 00 FF FF F0 E0 E1 18 FF F3 F8
					29 01 00 00 00 00 03 F0 A5 A5
					];

				qcom,mdss-dsi-panel-command-state = "dsi_lp_mode";
				qcom,mdss-dsi-seed-command-state = "dsi_lp_mode";
				qcom,mdss-dsi-on-command-state = "dsi_lp_mode";
				qcom,mdss-dsi-off-command-state = "dsi_hs_mode";
				qcom,mdss-dsi-h-sync-pulse = <0>;
		   /**************************************************************/
				qcom,mdss-dsi-panel-acl-command = [15 01 00 00 00 00 02 55 00];
				qcom,mdss-dsi-acl-command-state = "dsi_hs_mode";
				qcom,mdss-dsi-panel-hbm-on-command = [
				39 01 00 00 00 00 03 F0 5A 5A
				15 01 00 00 40 00 02 53 E8
				39 01 00 00 10 00 03 B2 02 D4
				15 01 00 00 00 00 02 F7 03
				39 01 00 00 00 00 03 F0 A5 A5
				];
				qcom,mdss-dsi-panel-hbm-on-command-2 = [
				39 01 00 00 00 00 03 F0 5A 5A
				15 01 00 00 40 00 02 53 E8
				39 01 00 00 10 00 03 B2 02 3C
				15 01 00 00 00 00 02 F7 03
				39 01 00 00 00 00 03 F0 A5 A5
				];
				qcom,mdss-dsi-panel-hbm-on-command-3 = [
				39 01 00 00 00 00 03 F0 5A 5A
				15 01 00 00 40 00 02 53 E8
				39 01 00 00 10 00 03 B2 01 9C
				15 01 00 00 00 00 02 F7 03
				39 01 00 00 00 00 03 F0 A5 A5
				];
				qcom,mdss-dsi-panel-hbm-on-command-4 = [
				39 01 00 00 00 00 03 F0 5A 5A
				15 01 00 00 40 00 02 53 E8
				39 01 00 00 10 00 03 B2 00 F0
				15 01 00 00 00 00 02 F7 03
				39 01 00 00 00 00 03 F0 A5 A5
				];
				qcom,mdss-dsi-panel-hbm-on-command-5 = [
				39 01 00 00 00 00 03 F0 5A 5A
				15 01 00 00 40 00 02 53 E8
				39 01 00 00 10 00 03 B2 00 40
				15 01 00 00 00 00 02 F7 03
				39 01 00 00 00 00 03 F0 A5 A5
				];
				qcom,mdss-dsi-panel-hbm-off-command = [
				39 01 00 00 00 00 03 F0 5A 5A
				15 01 00 00 00 00 02 53 28
				15 01 00 00 00 00 02 F7 03
				39 01 00 00 00 00 03 F0 A5 A5
				];
				qcom,mdss-dsi-panel-hbm-max-brightness-command-on = [
				39 01 00 00 00 00 03 F0 5A 5A
				15 01 00 00 40 00 02 53 E8
				39 01 00 00 10 00 03 B2 00 40
				15 01 00 00 00 00 02 F7 03
				39 01 00 00 00 00 03 F0 A5 A5
				];
				qcom,mdss-dsi-panel-hbm-max-brightness-command-off = [
				39 01 00 00 00 00 03 F0 5A 5A
				15 01 00 00 00 00 02 53 28
				15 01 00 00 00 00 02 F7 03
				39 01 00 00 00 00 03 F0 A5 A5
				];
				qcom,mdss-dsi-hbm-on-command-state = "dsi_lp_mode";
				qcom,mdss-dsi-hbm-off-command-state = "dsi_lp_mode";
				qcom,mdss-dsi-panel-hbm-max-brightness-command-on-state = "dsi_lp_mode";
				qcom,mdss-dsi-panel-hbm-max-brightness-command-off-state = "dsi_lp_mode";
				qcom,mdss-dsi-panel-aod-on-command-1 = [
					39 01 00 00 00 00 03 F0 5A 5A
					15 01 00 00 00 00 02 53 23
					05 01 00 00 00 00 02 38 00
					39 01 00 00 00 00 03 F0 A5 A5
				];
				qcom,mdss-dsi-panel-aod-on-command-2 = [
				];
				qcom,mdss-dsi-panel-aod-on-command-3 = [
					39 01 00 00 00 00 03 F0 5A 5A
					15 01 00 00 00 00 02 53 22
					05 01 00 00 00 00 02 38 00
					39 01 00 00 00 00 03 F0 A5 A5
				];
				qcom,mdss-dsi-panel-aod-on-command-4 = [
				];
				qcom,mdss-dsi-panel-aod-on-command-5 = [
					15 01 00 00 00 00 01 28
					39 01 00 00 12 00 03 F0 5A 5A
					15 01 00 00 00 00 02 B0 49
					15 01 00 00 00 00 02 CB FF
					15 01 00 00 00 00 02 B0 4F
					15 01 00 00 00 00 02 CB C8
					15 01 00 00 00 00 02 F7 03
					39 01 00 00 00 00 03 F0 A5 A5
					05 01 00 00 12 00 01 10
					05 01 00 00 82 00 01 11
					39 01 00 00 06 00 03 F0 5A 5A
					15 01 00 00 00 00 02 B0 01
					15 01 00 00 00 00 02 BB 03
					15 01 00 00 00 00 08 EF F0 31 00 33 31 14 35
					15 01 00 00 78 00 02 53 22
					05 01 00 00 01 00 02 38 00
					39 01 00 00 00 00 03 F0 A5 A5
					15 01 00 00 12 00 01 29
				];
				qcom,mdss-dsi-panel-aod-off-command = [
					39 01 00 00 00 00 03 F0 5A 5A
					15 01 00 00 00 00 02 53 28
					05 01 00 00 00 00 02 38 00
					39 01 00 00 00 00 03 F0 A5 A5
				];
				qcom,mdss-dsi-panel-aod-off-samsung-command = [
					39 01 00 00 00 00 03 F0 5A 5A
					15 01 00 00 00 00 02 53 28
					05 01 00 00 00 00 02 38 00
					39 01 00 00 00 00 03 F0 A5 A5
				];
				qcom,mdss-dsi-panel-aod-off-samsung-command-state = "dsi_lp_mode";
				qcom,mdss-dsi-panel-aod-off-new-command = [
					39 01 00 00 00 00 03 F0 5A 5A
					15 01 00 00 00 00 02 53 28
					05 01 00 00 00 00 02 38 00
					39 01 00 00 00 00 03 F0 A5 A5
				];
				qcom,mdss-dsi-panel-aod-off-new-command-state = "dsi_lp_mode";
				qcom,mdss-dsi-panel-aod-mode-command-1 = [
				39 01 00 00 00 00 03 F0 5A 5A
				15 01 00 00 00 00 02 53 23
				05 01 00 00 01 00 02 39 00
				39 01 00 00 00 00 03 F0 A5 A5
				];
				qcom,mdss-dsi-panel-aod-mode-command-2 = [
				39 01 00 00 00 00 03 F0 5A 5A
				15 01 00 00 00 00 02 53 22
				05 01 00 00 01 00 02 39 00
				39 01 00 00 00 00 03 F0 A5 A5
				];
				qcom,mdss-dsi-panel-aod-mode-command-3 = [
				39 01 00 00 00 00 03 F0 5A 5A
				15 01 00 00 00 00 02 53 23
				05 01 00 00 01 00 02 38 00
				39 01 00 00 00 00 03 F0 A5 A5
				];
				qcom,mdss-dsi-panel-aod-mode-command-4 = [
				39 01 00 00 00 00 03 F0 5A 5A
				15 01 00 00 00 00 02 53 22
				05 01 00 00 01 00 02 38 00
				39 01 00 00 00 00 03 F0 A5 A5
				];
				qcom,mdss-dsi-aod-on-command-state = "dsi_lp_mode";
				qcom,mdss-dsi-aod-off-command-state = "dsi_lp_mode";
				qcom,mdss-dsi-aod-mode-command-state = "dsi_lp_mode";
				qcom,mdss-dsi-panel-real-aod-off-hbm-on-command = [
					15 01 00 00 00 00 01 28
					39 01 00 00 12 00 03 F0 5A 5A
					15 01 00 00 00 00 02 B0 49
					15 01 00 00 00 00 02 CB FF
					15 01 00 00 00 00 02 B0 4F
					15 01 00 00 00 00 02 CB C8
					15 01 00 00 00 00 02 F7 03
					39 01 00 00 00 00 03 F0 A5 A5
					05 01 00 00 12 00 01 10
					05 01 00 00 82 00 01 11
					39 01 00 00 06 00 03 F0 5A 5A
					15 01 00 00 00 00 02 B0 01
					15 01 00 00 00 00 02 BB 03
					15 01 00 00 00 00 08 EF F0 31 00 33 31 14 35
					15 01 00 00 78 00 02 53 28
					05 01 00 00 01 00 02 38 00
					39 01 00 00 00 00 03 F0 A5 A5
					15 01 00 00 12 00 01 29
				];
				qcom,mdss-dsi-panel-real-aod-off-hbm-on-command-state = "dsi_hs_mode";
				qcom,mdss-dsi-panel-serial-num-command = [
					06 01 00 00 00 00 01 A1
				];
				qcom,mdss-dsi-panel-serial-num-command-state = "dsi_lp_mode";
				qcom,mdss-dsi-panel-display-srgb-color-mode-on-command = [
				39 01 00 00 00 00 03 f0 5A 5A
				39 01 00 00 00 00 03 E2 00 85
				39 01 00 00 00 00 02 B0 2C
				39 01 00 00 00 00 16 E2 CC 06 06 48 F8 18 01 01 D7 4F FE FD D0 12 E0 FF FB 1D FF FF FC
				39 01 00 00 00 00 02 b0 49
				39 01 00 00 00 00 02 E2 00
				39 01 00 00 00 00 02 b0 4A
				39 01 00 00 00 00 02 E2 00
				39 01 00 00 00 00 02 b0 4B
				39 01 00 00 00 00 02 E2 00
				39 01 00 00 00 00 02 b0 4C
				39 01 00 00 00 00 02 E2 00
				39 01 00 00 00 00 02 b0 4D
				39 01 00 00 00 00 02 E2 00
				39 01 00 00 00 00 03 f0 A5 A5
				];
				qcom,mdss-dsi-panel-display-p3-mode-on-command = [
				39 01 00 00 00 00 03 f0 5A 5A
				39 01 00 00 00 00 03 E2 00 85
				39 01 00 00 00 00 02 B0 2C
				39 01 00 00 00 00 16 E2 FF 00 00 12 F0 00 02 02 e9 19 FF FC ED 03 EC FC F9 00 FF FF FD
				39 01 00 00 00 00 02 b0 49
				39 01 00 00 00 00 02 E2 00
				39 01 00 00 00 00 02 b0 4A
				39 01 00 00 00 00 02 E2 00
				39 01 00 00 00 00 02 b0 4B
				39 01 00 00 00 00 02 E2 00
				39 01 00 00 00 00 02 b0 4C
				39 01 00 00 00 00 02 E2 00
				39 01 00 00 00 00 02 b0 4D
				39 01 00 00 00 00 02 E2 00
				39 01 00 00 00 00 03 f0 A5 A5
				];
				qcom,mdss-dsi-panel-display-wide-color-mode-on-command = [
				39 01 00 00 00 00 03 f0 5A 5A
				39 01 00 00 00 00 03 E2 00 85
				39 01 00 00 00 00 02 B0 2C
				39 01 00 00 00 00 16 E2 FF 00 00 00 FF 00 00 00 FF 00 FF FF FF 00 FF FF FF 00 FF FF FF
				39 01 00 00 00 00 02 b0 49
				39 01 00 00 00 00 02 E2 00
				39 01 00 00 00 00 02 b0 4A
				39 01 00 00 00 00 02 E2 00
				39 01 00 00 00 00 02 b0 4B
				39 01 00 00 00 00 02 E2 00
				39 01 00 00 00 00 02 b0 4C
				39 01 00 00 00 00 02 E2 00
				39 01 00 00 00 00 02 b0 4D
				39 01 00 00 00 00 02 E2 00
				39 01 00 00 00 00 03 f0 A5 A5
				];
				qcom,mdss-dsi-panel-dci-p3-off-command = [
				39 01 00 00 00 00 03 F0 5A 5A
				39 01 00 00 00 00 03 E2 00 40
				39 01 00 00 00 00 03 F0 A5 A5
				];
				qcom,mdss-dsi-customer-srgb-enable-command = [
				39 01 00 00 00 00 03 f0 5A 5A
				39 01 00 00 00 00 03 E2 00 85
				39 01 00 00 00 00 02 B0 2C
				39 01 00 00 00 00 16 E2 CC 06 06 48 F8 18 01 01 D7 4F FE FD D0 12 E0 FF FB 1D FF FF FC
				39 01 00 00 00 00 02 b0 49
				39 01 00 00 00 00 02 E2 00
				39 01 00 00 00 00 02 b0 4A
				39 01 00 00 00 00 02 E2 00
				39 01 00 00 00 00 02 b0 4B
				39 01 00 00 00 00 02 E2 00
				39 01 00 00 00 00 02 b0 4C
				39 01 00 00 00 00 02 E2 00
				39 01 00 00 00 00 02 b0 4D
				39 01 00 00 00 00 02 E2 00
				39 01 00 00 00 00 03 f0 A5 A5
			];
			qcom,mdss-dsi-customer-p3-enable-command = [
				39 01 00 00 00 00 03 f0 5A 5A
				39 01 00 00 00 00 03 E2 00 85
				39 01 00 00 00 00 02 B0 2C
				39 01 00 00 00 00 16 E2 FF 00 00 12 F0 00 02 02 e9 19 FF FC ED 03 EC FC F9 00 FF FF FD
				39 01 00 00 00 00 02 b0 49
				39 01 00 00 00 00 02 E2 00
				39 01 00 00 00 00 02 b0 4A
				39 01 00 00 00 00 02 E2 00
				39 01 00 00 00 00 02 b0 4B
				39 01 00 00 00 00 02 E2 00
				39 01 00 00 00 00 02 b0 4C
				39 01 00 00 00 00 02 E2 00
				39 01 00 00 00 00 02 b0 4D
				39 01 00 00 00 00 02 E2 00
				39 01 00 00 00 00 03 f0 A5 A5
			];

			qcom,mdss-dsi-panel-aod-on-command-1-state = "dsi_lp_mode";
			qcom,mdss-dsi-panel-aod-on-command-2-state = "dsi_lp_mode";
			qcom,mdss-dsi-panel-aod-on-command-3-state = "dsi_lp_mode";
			qcom,mdss-dsi-panel-aod-on-command-4-state = "dsi_lp_mode";
			qcom,mdss-dsi-panel-aod-on-command-5-state = "dsi_lp_mode";

			qcom,mdss-dsi-customer-p3-enable-command-state	= "dsi_lp_mode";
			qcom,mdss-dsi-customer-srgb-enable-command-state  = "dsi_lp_mode";
			qcom,mdss-dsi-laoding-effect-enable-command-state  = "dsi_lp_mode";
			qcom,mdss-dsi-laoding-effect-disable-command-state	= "dsi_lp_mode";
			qcom,mdss-dsi-panel-display-srgb-color-mode-on-command-state = "dsi_lp_mode";
			qcom,mdss-dsi-panel-display-p3-mode-on-command-state = "dsi_lp_mode";
			qcom,mdss-dsi-panel-display-wide-color-mode-on-command-state = "dsi_lp_mode";
			qcom,mdss-dsi-panel-night-mode-on-command-state = "dsi_lp_mode";
			qcom,mdss-dsi-panel-dci-p3-off-command-state = "dsi_lp_mode";
		    qcom,mdss-dsi-panel-status-command =
		    [06 01 00 01 05 00 02 0a 08];
		    qcom,mdss-dsi-panel-status-command-state = "dsi_lp_mode";

		    qcom,mdss-dsi-panel-id-command = [06 01 00 01 05 00 02 dc 08];
		    qcom,mdss-dsi-panel-id-command-state = "dsi_lp_mode";
				};
		};
	};
};
