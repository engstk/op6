/* Copyright (c) 2015-2017, The Linux Foundation. All rights reserved.
 *
 * This program is free software; you can redistribute it and/or modify
 * it under the terms of the GNU General Public License version 2 and
 * only version 2 as published by the Free Software Foundation.
 *
 * This program is distributed in the hope that it will be useful,
 * but WITHOUT ANY WARRANTY; without even the implied warranty of
 * MERCHANTABILITY or FITNESS FOR A PARTICULAR PURPOSE.  See the
 * GNU General Public License for more details.
 */

&mdss_mdp {
	dsi_samsung_dsc_cmd: qcom,mdss_dsi_samsung_dsc_cmd {
		qcom,mdss-dsi-panel-name = "samsung dsc cmd mode dsi panel";
		qcom,mdss-dsi-panel-manufacture = "SAMSUNG";
		qcom,mdss-dsi-panel-version = "DSC";
		qcom,mdss-dsi-backlight-version = "SAMSUNG";
		qcom,mdss-dsi-backlight-manufacture = "SAMSUNG";
		qcom,mdss-dsi-panel-type = "dsi_cmd_mode";
		qcom,mdss-dsi-virtual-channel-id = <0>;
		qcom,mdss-dsi-stream = <0>;
		qcom,mdss-dsi-bpp = <24>;
		qcom,mdss-dsi-underflow-color = <0xff>;
		qcom,mdss-dsi-border-color = <0>;
		qcom,mdss-dsi-reset-sequence = <1 5>, <0 2>, <1 10>;
		qcom,mdss-pan-physical-width-dimension = <68>;
		qcom,mdss-pan-physical-height-dimension = <145>;
		qcom,mdss-dsi-traffic-mode = "burst_mode";
		qcom,mdss-dsi-bllp-eof-power-mode;
		qcom,mdss-dsi-bllp-power-mode;
		qcom,mdss-dsi-lane-0-state;
		qcom,mdss-dsi-lane-1-state;
		qcom,mdss-dsi-lane-2-state;
		qcom,mdss-dsi-lane-3-state;
		qcom,mdss-dsi-dma-trigger = "trigger_sw";
		qcom,mdss-dsi-mdp-trigger = "none";
		qcom,mdss-dsi-te-pin-select = <1>;
		qcom,mdss-dsi-wr-mem-start = <0x2c>;
		qcom,mdss-dsi-wr-mem-continue = <0x3c>;
		qcom,mdss-dsi-te-dcs-command = <1>;
		qcom,mdss-dsi-te-check-enable;
		//qcom,esd-check-enabled;
		qcom,mdss-dsi-panel-status-check-mode = "reg_read";
		qcom,mdss-dsi-panel-status-command = [06 01 00 01 05 00 02 0A 08];
		qcom,mdss-dsi-panel-status-command-state = "dsi_hs_mode";
		qcom,mdss-dsi-panel-status-value = <0x9F>;
		qcom,mdss-dsi-panel-status-read-length = <1>;
		qcom,mdss-dsi-panel-id1-command = [06 01 00 01 05 00 02 0A 08];
		qcom,mdss-dsi-panel-id1-command-state = "dsi_hs_mode";
		qcom,mdss-dsi-panel-id2-command = [06 01 00 01 05 00 02 0E 08];
		qcom,mdss-dsi-panel-id2-command-state = "dsi_hs_mode";
		qcom,mdss-dsi-panel-id3-command = [06 01 00 01 05 00 02 E0 08];
		qcom,mdss-dsi-panel-id3-command-state = "dsi_hs_mode";
		qcom,mdss-dsi-panel-id4-command = [06 01 00 01 05 00 02 0F 08];
		qcom,mdss-dsi-panel-id4-command-state = "dsi_hs_mode";
		qcom,mdss-dsi-panel-id5-command = [06 01 00 01 05 00 02 E3 08];
		qcom,mdss-dsi-panel-id5-command-state = "dsi_hs_mode";
		qcom,mdss-dsi-panel-id6-command = [06 01 00 01 05 00 02 E5 08];
		qcom,mdss-dsi-panel-id6-command-state = "dsi_hs_mode";
		qcom,mdss-dsi-panel-id7-command = [06 01 00 01 05 00 02 FB 08];
		qcom,mdss-dsi-panel-id7-command-state = "dsi_hs_mode";
		
		qcom,mdss-dsi-panel-read-register-open-command = [
			39 01 00 00 00 00 03 FC 5A 5A];
		qcom,mdss-dsi-panel-read-register-close-command = [
			39 01 00 00 00 00 03 FC A5 A5];
		qcom,mdss-dsi-panel-read-register-open-command-state  = "dsi_hs_mode";
		qcom,mdss-dsi-panel-read-register-close-command-state = "dsi_hs_mode";

		qcom,mdss-dsi-te-using-te-pin;
		qcom,mdss-dsi-lp11-init;
	    qcom,mdss-dsi-high-brightness-panel;
		qcom,mdss-dsi-acl-cmd-index = <0>;
		qcom,mdss-dsi-acl-mode-index = <1>;
		qcom,mdss-bl-high2bit;		
	//	qcom,mdss-dsi-panel-status-check-mode = "te_signal_check";
		qcom,mdss-dsi-panel-seria-num-year-index = <12>;
		qcom,mdss-dsi-panel-seria-num-mon-index = <12>;
		qcom,mdss-dsi-panel-seria-num-day-index = <13>;
		qcom,mdss-dsi-panel-seria-num-hour-index = <14>;
		qcom,mdss-dsi-panel-seria-num-min-index = <15>;
		qcom,ulps-enabled;
		qcom,mdss-dsi-display-timings {
			timing@0{
				qcom,mdss-dsi-panel-framerate = <60>;
				qcom,mdss-dsi-panel-width = <1080>;
				qcom,mdss-dsi-panel-height = <2340>;
				qcom,mdss-dsi-h-front-porch = <72>;
				qcom,mdss-dsi-h-back-porch = <36>;
				qcom,mdss-dsi-h-pulse-width = <16>;
				qcom,mdss-dsi-h-sync-skew = <0>;
				qcom,mdss-dsi-v-back-porch = <18>;
				qcom,mdss-dsi-v-front-porch = <32>;
				qcom,mdss-dsi-v-pulse-width = <4>;
				qcom,mdss-dsi-h-left-border = <0>;
				qcom,mdss-dsi-h-right-border = <0>;
				qcom,mdss-dsi-v-top-border = <0>;
				qcom,mdss-dsi-v-bottom-border = <0>;
				qcom,mdss-dsi-panel-jitter = <0x4 0x1>;
				//qcom,mdss-dsi-panel-clockrate = <1037000000>;//	518.5MHZ
				qcom,mdss-dsi-on-command = [
				
				
				 29 00 00 00 00 00 03 F0 5A 5A		
				 07 01 00 00 00 00 01 01			/* DSC enable :  Compression Mode*/
				 29 01 00 00 00 00 5A 0A 11 00 00 89 30 80 09 24 04 38 00 3C 02 1C 02 1C
				 02 00 02 0E 00 20 05 D2
				 00 07 00 0C 01 A1 01 B2
				 18 00 10 F0 03 0C 20 00
				 06 0B 0B 33 0E 1C 2A 38
				 46 54 62 69 70 77 79 7B
				 7D 7E 01 02 01 00 09 40
				 09 BE 19 FC 19 FA 19 F8
				 1A 38 1A 78 1A B6 2A F6
				 2B 34 2B 74 3B 74 6B F4 00 
				 29 00 00 00 00 00 03 F0 A5 A5
				
				
				
					05 01 00 00 78 00 01 11 
				
					39 01 00 00 00 00 03 FC 5A 5A  /*OSC Speed */
					39 01 00 00 00 00 02 B0 09
					39 01 00 00 00 00 02 D7 2A
					39 01 00 00 00 00 02 FE B0
					39 01 00 00 00 00 02 FE 30
					39 01 00 00 00 00 03 FC A5 A5	
				
					15 01 00 00 00 00 02 35 00
				
					39 01 00 00 00 00 03 F0 5A 5A
					15 01 00 00 00 00 02 53 20
					39 01 00 00 00 00 03 F0 A5 A5
				
					39 01 00 00 00 00 03 F0 5A 5A
				  39 01 00 00 00 00 02 9D 01
				  39 01 00 00 00 00 03 F0 A5 A5
				
					39 01 00 00 00 00 03 FC 5A 5A		/*FFC Setting*/
					39 01 00 00 00 00 06 C5 0D 10 B4 62 1A
					39 01 00 00 00 00 03 FC A5 A5
				
				  05 01 00 00 00 00 02 29 00];


				qcom,mdss-dsi-off-command = [
			
				  /*Display off Delay 20ms*/
					05 01 00 00 14 00 02 28 00
					/*Sleep in*/
					05 01 00 00 00 00 02 10 00
	
					];
				qcom,mdss-dsi-on-command-state = "dsi_lp_mode";
				qcom,mdss-dsi-off-command-state = "dsi_lp_mode";
				qcom,mdss-dsi-h-sync-pulse = <0>;

				qcom,compression-mode = "dsc";
				qcom,mdss-dsc-slice-height = <60>;
				qcom,mdss-dsc-slice-width = <540>;
				qcom,mdss-dsc-slice-per-pkt = <2>;
				qcom,mdss-dsc-bit-per-component = <8>;
				qcom,mdss-dsc-bit-per-pixel = <8>;
				qcom,mdss-dsc-block-prediction-enable;



				
		   /**************************************************************/
				qcom,mdss-dsi-panel-hbm-on-command = [
				39 01 00 00 00 00 03 51 00 26
				39 01 00 00 00 00 02 53 E0
				];
				qcom,mdss-dsi-panel-hbm-on-command-2 = [
				39 01 00 00 00 00 03 51 00 78
				39 01 00 00 00 00 02 53 E0
				];
				qcom,mdss-dsi-panel-hbm-on-command-3 = [
				39 01 00 00 00 00 03 51 00 CA
				39 01 00 00 00 00 02 53 E0
				];
				qcom,mdss-dsi-panel-hbm-on-command-4 = [
				39 01 00 00 00 00 03 51 01 2A
				39 01 00 00 00 00 02 53 E0
				];
				qcom,mdss-dsi-panel-hbm-on-command-5 = [
				39 01 00 00 00 00 03 51 03 FF
				39 01 00 00 00 00 02 53 E0
				];
				qcom,mdss-dsi-panel-hbm-off-command = [
				39 01 00 00 00 00 02 53 20
				];

				qcom,mdss-dsi-hbm-on-command-state = "dsi_lp_mode";
				qcom,mdss-dsi-hbm-off-command-state = "dsi_lp_mode";
				qcom,mdss-dsi-panel-aod-on-command-1 = [
					05 01 00 00 23 00 02 28 00
					05 01 00 00 78 00 02 10 00
					05 01 00 00 0A 00 02 11 00
					39 01 00 00 00 00 03 F0 5A 5A
					15 01 00 00 00 00 02 B0 01
					15 01 00 00 00 00 02 CD 02
					15 01 00 00 00 00 02 35 00
					39 01 00 00 00 00 08 EB 17 41 92 0E 10 82 5A
					39 01 00 00 00 00 05 2A 00 00 04 37
					39 01 00 00 00 00 05 2B 00 00 09 23
					39 01 00 00 00 00 02 B0 09
					39 01 00 00 00 00 03 E8 10 30
					15 01 00 00 00 00 02 53 23  /*AOD Low mode 10nit*/
					15 01 00 00 00 00 02 B0 A5
					15 01 00 00 00 00 02 C7 01  /*ALPM*/
					39 01 00 00 00 00 03 F0 A5 A5
					05 01 00 00 00 00 02 29 00
				];
				qcom,mdss-dsi-panel-aod-on-command-2 = [
					05 01 00 00 23 00 02 28 00
					05 01 00 00 78 00 02 10 00
					05 01 00 00 0A 00 02 11 00
					39 01 00 00 00 00 03 F0 5A 5A
					15 01 00 00 00 00 02 B0 01
					15 01 00 00 00 00 02 CD 02
					15 01 00 00 00 00 02 35 00
					39 01 00 00 00 00 08 EB 17 41 92 0E 10 82 5A
					39 01 00 00 00 00 05 2A 00 00 04 37
					39 01 00 00 00 00 05 2B 00 00 09 23
					39 01 00 00 00 00 02 B0 09
					39 01 00 00 00 00 03 E8 10 30
					15 01 00 00 00 00 02 53 22 /*AOD Low mode 50nit*/
					15 01 00 00 00 00 02 B0 A5
					15 01 00 00 00 00 02 C7 01 /*ALPM*/
					39 01 00 00 00 00 03 F0 A5 A5
					05 01 00 00 00 00 02 29 00
				];
				qcom,mdss-dsi-panel-aod-on-command-3 = [

				05 01 00 00 23 00 02 28 00
				05 01 00 00 78 00 02 10 00
				05 01 00 00 0A 00 02 11 00
				39 01 00 00 00 00 03 F0 5A 5A
				15 01 00 00 00 00 02 B0 01
				15 01 00 00 00 00 02 CD 02
				15 01 00 00 00 00 02 35 00
				39 01 00 00 00 00 08 EB 17 41 92 0E 10 82 5A
				39 01 00 00 00 00 05 2A 00 00 04 37
				39 01 00 00 00 00 05 2B 00 00 09 23
				39 01 00 00 00 00 02 B0 09
				39 01 00 00 00 00 03 E8 10 30
				15 01 00 00 00 00 02 53 23/*AOD Low mode 10nit*/
				15 01 00 00 00 00 02 B0 A5
				15 01 00 00 00 00 02 C7 00 /*HLPM*/
				39 01 00 00 00 00 03 F0 A5 A5
				05 01 00 00 00 00 02 29 00
				];
				qcom,mdss-dsi-panel-aod-on-command-4 = [
					39 01 00 00 00 00 03 9F A5 A5
					05 01 00 00 0A 00 01 28
					05 01 00 00 78 00 01 10
					05 01 00 00 0A 00 01 11
					39 01 00 00 00 00 03 F0 5A 5A
					15 01 00 00 00 00 02 B0 01
					15 01 00 00 20 00 02 CD 01
					39 01 00 00 00 00 03 F0 A5 A5
					39 01 00 00 00 00 03 F0 5A 5A
					15 01 00 00 00 00 02 B0 01
					15 01 00 00 14 00 02 CD 02
					39 01 00 00 00 00 03 51 03 FF
					15 01 00 00 00 00 02 53 22
					15 01 00 00 00 00 02 B0 A5
					15 01 00 00 00 00 02 C7 00
					39 01 00 00 00 00 03 F0 A5 A5
					05 01 00 00 00 00 01 29
					39 01 00 00 00 00 03 9F 5A 5A

				];
				qcom,mdss-dsi-panel-aod-off-command = [
					39 01 00 00 00 00 03 F0 5A 5A
					15 01 00 00 00 00 02 B0 01
					15 01 00 00 00 00 02 CD 01
					39 01 00 00 00 00 02 53 20
					39 01 00 00 00 00 03 F0 A5 A5

				];
				qcom,mdss-dsi-panel-aod-mode-command-1 = [
				39 01 00 00 00 00 03 F0 5A 5A
				15 01 00 00 00 00 02 53 23
				15 01 00 00 00 00 02 B0 A5
				15 01 00 00 00 00 02 C7 01
				39 01 00 00 00 00 03 F0 A5 A5

				];
				qcom,mdss-dsi-panel-aod-mode-command-2 = [
				39 01 00 00 00 00 03 F0 5A 5A
				15 01 00 00 00 00 02 53 22
				15 01 00 00 00 00 02 B0 A5
				15 01 00 00 00 00 02 C7 01
				39 01 00 00 00 00 03 F0 A5 A5

				];
				qcom,mdss-dsi-panel-aod-mode-command-3 = [
				39 01 00 00 00 00 03 F0 5A 5A
				15 01 00 00 00 00 02 53 23
				15 01 00 00 00 00 02 B0 A5
				15 01 00 00 00 00 02 C7 00
				39 01 00 00 00 00 03 F0 A5 A5

				];
				qcom,mdss-dsi-panel-aod-mode-command-4 = [
				39 01 00 00 00 00 03 F0 5A 5A
				15 01 00 00 00 00 02 53 22
				15 01 00 00 00 00 02 B0 A5
				15 01 00 00 00 00 02 C7 00
				39 01 00 00 00 00 03 F0 A5 A5
				];

				qcom,mdss-dsi-aod-on-command-state = "dsi_hs_mode";
				qcom,mdss-dsi-aod-off-command-state = "dsi_hs_mode";
				qcom,mdss-dsi-aod-mode-command-state = "dsi_lp_mode";
				qcom,mdss-dsi-panel-serial-num-command = [
					06 01 00 00 00 00 01 A1
				];
				qcom,mdss-dsi-panel-serial-num-command-state = "dsi_lp_mode";

				qcom,mdss-dsi-panel-srgb-on-command = [
					39 01 00 00 00 00 02 81 90
					39 01 00 00 00 00 03 f0 5A 5A
					39 01 00 00 00 00 02 B0 02
					39 01 00 00 00 00 16 B1 A3 05 04 46 cd 10 05 09 b0 57 ef cf bb 11 bf e1 da 17 ff f9 d8
					39 01 00 00 00 00 03 B1 00 00
					39 01 00 00 00 00 03 f0 A5 A5
				];
				qcom,mdss-dsi-panel-srgb-off-command = [
					39 01 00 00 00 00 02 81 00
					39 01 00 00 00 00 03 F0 5A 5A
					39 01 00 00 00 00 03 B1 00 01  /* SEED CRC OFF */
					39 01 00 00 00 00 03 B3 00 C1  /* TCS OFF */
					39 01 00 00 00 00 03 F0 A5 A5

				];
				qcom,mdss-dsi-srgb-on-command-state = "dsi_lp_mode";
				qcom,mdss-dsi-srgb-off-command-state = "dsi_lp_mode";

				qcom,mdss-dsi-panel-dci-p3-on-command = [
				39 01 00 00 00 00 02 81 90
				39 01 00 00 00 00 03 f0 5A 5A
				39 01 00 00 00 00 02 B0 02
				39 01 00 00 00 00 16 B1 C6 00 00 1e cf 00 06 0a c3 26 ef cd e0 04 ce e9 df 00 ff f9 d8
				39 01 00 00 00 00 03 B1 00 00
				39 01 00 00 00 00 03 f0 A5 A5
				];
				qcom,mdss-dsi-panel-dci-p3-off-command = [
					39 01 00 00 00 00 02 81 00
					39 01 00 00 00 00 03 F0 5A 5A
					39 01 00 00 00 00 03 B1 00 01  /* SEED CRC OFF */
					39 01 00 00 00 00 03 B3 00 C1  /* TCS OFF */
					39 01 00 00 00 00 03 F0 A5 A5

				];
				qcom,mdss-dsi-dci-p3-on-command-state = "dsi_lp_mode";
				qcom,mdss-dsi-dci-p3-off-command-state = "dsi_lp_mode";

				qcom,mdss-dsi-panel-night-mode-on-command = [
					39 01 00 00 00 00 02 81 90
				    39 01 00 00 00 00 03 f0 5A 5A
				    39 01 00 00 00 00 02 B0 02
					39 01 00 00 00 00 16 B1 A0 02 04 3B C7 12 08 07 A8 4B E7 C9 BF 0A B9 E3 DA 18 FF FE FA
					39 01 00 00 00 00 03 B1 00 00
					39 01 00 00 00 00 03 f0 A5 A5
				];
				qcom,mdss-dsi-panel-night-mode-off-command = [
					39 01 00 00 00 00 02 81 00
					39 01 00 00 00 00 03 F0 5A 5A
					39 01 00 00 00 00 03 B1 00 01  /* SEED CRC OFF */
					39 01 00 00 00 00 03 B3 00 C1  /* TCS OFF */
					39 01 00 00 00 00 03 F0 A5 A5

				];
				qcom,mdss-dsi-night-mode-on-command-state = "dsi_lp_mode";
				qcom,mdss-dsi-night-mode-off-command-state = "dsi_lp_mode";

				qcom,mdss-dsi-panel-oneplus-mode-on-command = [
					39 01 00 00 00 00 02 81 90
				    39 01 00 00 00 00 03 f0 5A 5A
				    39 01 00 00 00 00 02 B0 02
					39 01 00 00 00 00 16 B1 b4 02 04 05 ff 02 00 00 ff 00 ff ff f0 00 f0 e0 e1 18 ff fe fB
					39 01 00 00 00 00 03 B1 00 00
					39 01 00 00 00 00 03 f0 A5 A5
				];
				qcom,mdss-dsi-panel-oneplus-mode-off-command = [
					39 01 00 00 00 00 02 81 00
					39 01 00 00 00 00 03 F0 5A 5A
					39 01 00 00 00 00 03 B1 00 01  /* SEED CRC OFF */
					39 01 00 00 00 00 03 B3 00 C1  /* TCS OFF */
					39 01 00 00 00 00 03 F0 A5 A5

				];
				qcom,mdss-dsi-panel-oneplus-mode-on-command-state = "dsi_lp_mode";
				qcom,mdss-dsi-panel-oneplus-mode-off-command-state = "dsi_lp_mode";

				qcom,mdss-dsi-panel-adaption-mode-on-command = [
					39 01 00 00 00 00 02 81 90
				    39 01 00 00 00 00 03 f0 5A 5A
				    39 01 00 00 00 00 02 B0 02
					39 01 00 00 00 00 16 B1 B8 03 04 45 E2 10 04 07 C1 4B EB D7 B8 0A BF FF ED 14 FF FF FA
					39 01 00 00 00 00 03 B1 00 00
					39 01 00 00 00 00 03 f0 A5 A5
				];
				qcom,mdss-dsi-panel-adaption-mode-off-command = [
					39 01 00 00 00 00 02 81 00
					39 01 00 00 00 00 03 F0 5A 5A
					39 01 00 00 00 00 03 B1 00 01  /* SEED CRC OFF */
					39 01 00 00 00 00 03 B3 00 C1  /* TCS OFF */
					39 01 00 00 00 00 03 F0 A5 A5

				];
				qcom,mdss-dsi-adaption-mode-on-command-state = "dsi_lp_mode";
				qcom,mdss-dsi-adaption-mode-off-command-state = "dsi_lp_mode";
		    	qcom,mdss-dsi-panel-status-command = [06 01 00 01 05 00 02 0A 08];
		   		qcom,mdss-dsi-panel-status-command-state = "dsi_lp_mode";
				qcom,mdss-dsi-panel-id-command = [06 01 00 01 05 00 02 DC 08];
		        qcom,mdss-dsi-panel-id-command-state = "dsi_lp_mode";
				qcom,mdss-dsi-panel-id1-command = [06 01 00 01 05 00 02 0A 08];
				qcom,mdss-dsi-panel-id1-command-state = "dsi_hs_mode";
				qcom,mdss-dsi-panel-id2-command = [06 01 00 01 05 00 02 0E 08];
				qcom,mdss-dsi-panel-id2-command-state = "dsi_hs_mode";
				qcom,mdss-dsi-panel-id3-command = [06 01 00 01 05 00 02 E0 08];
				qcom,mdss-dsi-panel-id3-command-state = "dsi_hs_mode";
				qcom,mdss-dsi-panel-id4-command = [06 01 00 01 05 00 02 0F 08];
				qcom,mdss-dsi-panel-id4-command-state = "dsi_hs_mode";
				qcom,mdss-dsi-panel-id5-command = [06 01 00 01 05 00 02 E3 08];
				qcom,mdss-dsi-panel-id5-command-state = "dsi_hs_mode";
				qcom,mdss-dsi-panel-id6-command = [06 01 00 01 05 00 02 E5 08];
				qcom,mdss-dsi-panel-id6-command-state = "dsi_hs_mode";
				qcom,mdss-dsi-panel-id7-command = [06 01 00 01 05 00 02 FB 08];
				qcom,mdss-dsi-panel-id7-command-state = "dsi_hs_mode";

				qcom,mdss-dsi-panel-read-register-open-command = [
					39 01 00 00 00 00 03 FC 5A 5A];
				qcom,mdss-dsi-panel-read-register-close-command = [
					39 01 00 00 00 00 03 FC A5 A5];
				qcom,mdss-dsi-panel-read-register-open-command-state  = "dsi_hs_mode";
				qcom,mdss-dsi-panel-read-register-close-command-state = "dsi_hs_mode";
			
				};
		};
	};
};
